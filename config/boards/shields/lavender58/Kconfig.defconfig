## config/boards/shields/lavender58/Kconfig.defconfig
```kconfig
# Copyright (c) 2022 The ZMK Contributors
# SPDX-License-Identifier: MIT

if SHIELD_LAVENDER58_LEFT

config ZMK_KEYBOARD_NAME
	default "Lavender58"

config ZMK_SPLIT_ROLE_CENTRAL
	default y
	
endif

if SHIELD_LAVENDER58_LEFT || SHIELD_LAVENDER58_RIGHT

config ZMK_SPLIT
	default y

endif
```

## zmk/config/boards/shields/lavender58/Kconfig.shield
```kconfig
# Copyright (c) 2022 The ZMK Contributors
# SPDX-License-Identifier: MIT

config SHIELD_LAVENDER58_LEFT
	def_bool $(shields_list_contains,lavender58_left)

config SHIELD_LAVENDER58_RIGHT
	def_bool $(shields_list_contains,lavender58_right)
```
